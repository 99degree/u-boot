// SPDX-License-Identifier: GPL-2.0

/* Needed for Linux to boot from USB, otherwise if PCIe driver is not in initramfs
 * the VBUS supply will never get turned on.
 * https://lore.kernel.org/linux-arm-msm/20240320122515.3243711-1-caleb.connolly@linaro.org/
 */
&pcie0_3p3v_dual {
	regulator-always-on;
};

/* This GPIO must be turned on to enable the 5v VBUS
 * supply on the USB port.
 */
&usb_2_dwc3 {
	vbus-supply = <&pcie0_3p3v_dual>;
};
