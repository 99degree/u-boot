// SPDX-License-Identifier: GPL-2.0+
/*
 * U-Boot addition to handle QCS404 EVB pre-relocation devices
 *
 * (C) Copyright 2022 Sumit Garg <sumit.garg@linaro.org>
 */

&pms405_gpios {
	usb_vbus_boost_pin {
		gpios = <&pms405_gpios 2 0>;
	};
};
