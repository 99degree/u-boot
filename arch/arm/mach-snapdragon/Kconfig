## configs/rbx_defconfig
```kconfig
CONFIG_ARM=y
CONFIG_SKIP_LOWLEVEL_INIT=y
CONFIG_POSITION_INDEPENDENT=y
CONFIG_ARCH_SNAPDRAGON=y
CONFIG_DEFAULT_DEVICE_TREE="dragonboard845c"
CONFIG_DM_RESET=y
CONFIG_TARGET_QCOM_RBX=y
CONFIG_IDENT_STRING="\n\tQualcomm Robotics"
CONFIG_SYS_LOAD_ADDR=0x80000000
CONFIG_FIT=y
CONFIG_VIDEO_FONT_12X32=n
CONFIG_FIT_VERBOSE=y
CONFIG_BOOTDELAY=1
CONFIG_SAVE_PREV_BL_FDT_ADDR=y
CONFIG_SAVE_PREV_BL_INITRAMFS_START_ADDR=y
CONFIG_USE_PREV_BL_FDT=y
# CONFIG_DISPLAY_CPUINFO is not set
CONFIG_HUSH_PARSER=y
CONFIG_SYS_MAXARGS=64
CONFIG_SYS_CBSIZE=512
CONFIG_BUTTON=y
CONFIG_BUTTON_GPIO=y
CONFIG_DM_KEYBOARD=y
CONFIG_BUTTON_KEYBOARD=y
CONFIG_CMD_CLK=y
CONFIG_CMD_GPIO=y
CONFIG_CMD_PART=y
CONFIG_CMD_UFS=y
CONFIG_CMD_CAT=y
CONFIG_CMD_FS_GENERIC=y # for load cmd
CONFIG_DOS_PARTITION=y
CONFIG_EFI_PARTITION=y
CONFIG_CMD_BOOTDEV=y
CONFIG_BOOTMETH_SCRIPT=n
CONFIG_BOOTMETH_EXTLINUX=n
CONFIG_BOOTMETH_VBE=n
CONFIG_BOOTSTD_FULL=y
CONFIG_BOOTSTD_IGNORE_BOOTABLE=y
CONFIG_CMD_BOOTMENU=y
CONFIG_BOOTMENU_LOOP=y
CONFIG_AUTOBOOT_USE_MENUKEY=y
# ESCAPE code (volume buttons)
CONFIG_AUTOBOOT_MENUKEY=27
# CONFIG_BOOT_RETRY=y
# CONFIG_BOOT_RETRY_TIME=1
# CONFIG_NET is not set
CONFIG_USB_FUNCTION_ACM=y # USB serial
CONFIG_CLK=y
CONFIG_MSM_GPIO=y
CONFIG_QCOM_PMIC_GPIO=y
CONFIG_SOC_QCOM=y
CONFIG_QCOM_COMMAND_DB=y
CONFIG_QCOM_RPMH=y
CONFIG_DM_REGULATOR_QCOM_RPMH=y
CONFIG_PHY=y
CONFIG_PHY_QCOM_QMP_UFS=y
CONFIG_PINCTRL=y
CONFIG_SYSINFO=y
CONFIG_SYSINFO_SMBIOS=y
CONFIG_DM_PMIC=y
CONFIG_PMIC_QCOM=y
CONFIG_SCSI=y
CONFIG_DM_SCSI=y
CONFIG_MSM_GENI_SERIAL=y
CONFIG_SPMI_MSM=y
CONFIG_UFS=y
CONFIG_QCOM_UFS=y
CONFIG_LMB_MAX_REGIONS=64
CONFIG_VIDEO=y
CONFIG_VIDEO_FONT_8X16=n
CONFIG_VIDEO_FONT_SUN12X22=n
CONFIG_VIDEO_FONT_16X32=y
CONFIG_SYS_WHITE_ON_BLACK=y
CONFIG_NO_FB_CLEAR=y
CONFIG_VIDEO_SIMPLE=y
CONFIG_PHY_QCOM_QUSB2=y
CONFIG_PHY_QCOM_USB_HS_7NM=y
CONFIG_USB=y
CONFIG_CMD_USB=y
CONFIG_DM_USB=y
CONFIG_DM_USB_GADGET=y
CONFIG_USB_GADGET=y
CONFIG_USB_FUNCTION_FASTBOOT=y
CONFIG_FASTBOOT_OEM_RUN=y
CONFIG_FASTBOOT_BUF_ADDR=0xa0000000
CONFIG_CMD_USB_MASS_STORAGE=y
CONFIG_CMD_UMS_ABORT_KEYED=y
CONFIG_USB_FUNCTION_MASS_STORAGE=y
CONFIG_FASTBOOT_GPT_NAME="partition"
CONFIG_USE_PREBOOT=y
CONFIG_USB_STORAGE=y
CONFIG_USB_DWC3=y
CONFIG_USB_DWC3_GENERIC=y
CONFIG_USB_XHCI_HCD=y
CONFIG_USB_XHCI_DWC3=y
CONFIG_MMC_SDHCI=y
CONFIG_MMC_SDHCI_MSM=y
CONFIG_CMD_MMC=y
CONFIG_CMD_FAT=y

CONFIG_BAUDRATE=115200

# Uncomment to enable UART pre-relocation
#CONFIG_DEBUG_UART=y
CONFIG_DEBUG_UART_ANNOUNCE=y
# rb3
CONFIG_DEBUG_UART_BASE=0x00a90000
# rb1
#CONFIG_DEBUG_UART_BASE=0x4a90000
CONFIG_DEBUG_UART_MSM_GENI=y
#CONFIG_DEBUG_UART_CLOCK=7372800
# For rb1, 2x the rate (oversampling bug?)
CONFIG_DEBUG_UART_CLOCK=14745600
CONFIG_DEBUG_UART_SKIP_INIT=y

# Logging
CONFIG_LOG=y
CONFIG_HEXDUMP=y
CONFIG_CMD_LOG=y
CONFIG_LOG_MAX_LEVEL=9
CONFIG_LOG_DEFAULT_LEVEL=4
CONFIG_LOGLEVEL=4
```

## configs/x1e_defconfig
```kconfig
#include "qcom_defconfig"

CONFIG_EFI=y
CONFIG_EFI_STUB=y
CONFIG_EFI_STUB_64BIT=y

CONFIG_DEBUG_UART=y
CONFIG_DEBUG_UART_ANNOUNCE=y
CONFIG_DEBUG_UART_BASE=0x894000
CONFIG_DEBUG_UART_MSM_GENI=y
CONFIG_DEBUG_UART_CLOCK=14745600

CONFIG_DEFAULT_ENV_FILE="board/qualcomm/efistub.env"
CONFIG_DEFAULT_DEVICE_TREE="qcom/x1e80100-crd"
```

## drivers/clk/qcom/Kconfig
```kconfig
config CLK_QCOM_DEBUG
	bool "Enable Qualcomm clock debugging"
	depends on ARCH_SNAPDRAGON
	select CMD_CLK
	help
	  Enable support for debugging the Qualcomm Global Clock
	  Controller on supported platforms. The hardware implements
	  the ability to measure the output rates of most clocks, so
	  that clock configurations can be validated. Use the "clk debug"
	  command.
```

## drivers/pinctrl/qcom/Kconfig
```kconfig
if ARCH_SNAPDRAGON

config PINCTRL_SNAPDRAGON
	bool "Qualcomm Snapdragon pin control drivers"
	depends on ARCH_SNAPDRAGON && PINCTRL_GENERIC
	default y
	help
	  Enable support pin control functions for Qualcomm SoCs.

endif
```
