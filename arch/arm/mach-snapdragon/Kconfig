## arch/arm/mach-snapdragon/Kconfig
```kconfig
if ARCH_SNAPDRAGON

config SYS_SOC
	default "snapdragon"

config SYS_BOARD
	string "Board name"

config SYS_MALLOC_F_LEN
	default 0x2000

config SPL_SYS_MALLOC_F
	default y

config SPL_SYS_MALLOC_F_LEN
	default 0x2000

config LNX_KRNL_IMG_TEXT_OFFSET_BASE
	default 0x80000000

choice
	prompt "Snapdragon board select"

config TARGET_DRAGONBOARD410C
	bool "96Boards Dragonboard 410C"
	select BOARD_LATE_INIT
	imply CLK_QCOM_APQ8016
	imply PINCTRL_QCOM_APQ8016
	imply BUTTON_QCOM_PMIC
	help
	  Support for 96Boards Dragonboard 410C. This board complies with
	  96Board Open Platform Specifications. Features:
	  - Qualcomm Snapdragon 410C SoC - APQ8016 (4xCortex A53, Adreno 306)
	  - 1GiB RAM
	  - 8GiB eMMC, uSD slot
	  - WiFi, Bluetooth and GPS module
	  - 2x Host, 1x Device USB port
	  - HDMI
	  - 20-pin low speed and 40-pin high speed expanders, 4 LED, 3 buttons

	  Enable CONFIG_LINUX_KERNEL_IMAGE_HEADER to support running U-Boot as
	  a chainloaded bootloader, or enable CONFIG_ENABLE_ARM_SOC_BOOT0_HOOK
	  if you intend to run U-Boot as the primary bootloader.

config TARGET_DRAGONBOARD820C
	bool "96Boards Dragonboard 820C"
	imply CLK_QCOM_APQ8096
	imply PINCTRL_QCOM_APQ8096
	imply BUTTON_QCOM_PMIC
	help
	  Support for 96Boards Dragonboard 820C. This board complies with
	  96Board Open Platform Specifications. Features:
	  - Qualcomm Snapdragon 820C SoC - APQ8096 (4xKyro CPU)
	  - 3GiB RAM
	  - 32GiB UFS drive

config TARGET_QCOM
	bool "Qualcomm generic board support"
	select BOARD_LATE_INIT
	select SAVE_PREV_BL_FDT_ADDR
	select OF_BOARD
	imply LINUX_KERNEL_IMAGE_HEADER
	imply BUTTON_QCOM_PMIC
	help
	  Stub target for generic Qualcomm board support. This target currently
	  support the Dragonboard845c and starqltechn boards, all new Qualcomm
	  boards should use this target.

endchoice

source "board/qualcomm/dragonboard410c/Kconfig"
source "board/qualcomm/dragonboard820c/Kconfig"
source "board/qualcomm/generic/Kconfig"

endif
```

## board/qualcomm/qrb4210-rb2/Kconfig
```kconfig
if TARGET_QRB4210RB2

config SYS_BOARD
	default "qrb4210-rb2"

config SYS_VENDOR
	default "qualcomm"

config SYS_SOC
	default "sm6115"

config SYS_CONFIG_NAME
	default "qrb4210-rb2"

endif
```

## board/qualcomm/qrb4210-rb2/qrb4210-rb2.its
```
/*
 * U-Boot uImage source file with multiple kernels, ramdisks and FDT blobs
 */

/dts-v1/;

/ {
	description = "Various kernels, ramdisks and FDT blobs";
	#address-cells = <1>;

	images {
		kernel-1 {
			description = "6.2-rc8";
			data = /incbin/("./qrb4210rb2_imgs/Image.gz");
			type = "kernel";
			arch = "arm64";
			os = "linux";
			compression = "gzip";
			load = <0x80000000>;
			entry = <0x80000000>;
			hash-1 {
				algo = "sha1";
			};
		};

		ramdisk-1 {
			description = "Initial ramdisk";
			data = /incbin/("./qrb4210rb2_imgs/initramfs-test-image-qemuarm64-20230209073803-1343.rootfs.cpio.gz");
			type = "ramdisk";
			arch = "arm64";
			os = "linux";
			compression = "gzip";
			load = <00000000>;
			entry = <00000000>;
			hash-1 {
				algo = "sha1";
			};
		};

		fdt-1 {
			description = "qrb4210-rb2-fdt";
			data = /incbin/("./qrb4210rb2_imgs/qrb4210-rb2.dtb");
			type = "flat_dt";
			arch = "arm64";
			compression = "none";
			load = <0x83000000>;
			hash-1 {
				algo = "sha1";
			};
		};

	};

	configurations {
		default = "config-1";

		config-1 {
			description = "qrb4210-rb2 kernel-6.2-rc8 configuration";
			kernel = "kernel-1";
			ramdisk = "ramdisk-1";
			fdt = "fdt-1";
		};
	};
};
```

## board/qualcomm/qrb5165-rb5/Kconfig
```kconfig
if TARGET_QRB5165RB5

config SYS_BOARD
	default "qrb5165-rb5"

config SYS_VENDOR
	default "qualcomm"

config SYS_SOC
	default "sm8250"

config SYS_CONFIG_NAME
	default "qrb5165-rb5"

endif
```

## board/qualcomm/rb1/Kconfig
```kconfig
if TARGET_RB1

config SYS_BOARD
	default "rb1"

config SYS_VENDOR
	default "qualcomm"

config SYS_SOC
	default "qcm2290"

config SYS_CONFIG_NAME
	default "rb1"

endif
```

## board/qualcomm/rb1/rb1.its
```
/*
 * U-Boot uImage source file with multiple kernels, ramdisks and FDT blobs
 */

/dts-v1/;

/ {
	description = "Various kernels, ramdisks and FDT blobs";
	#address-cells = <1>;

	images {
		kernel-1 {
			description = "6.2-rc8";
			data = /incbin/("./rb1_imgs/Image.gz");
			type = "kernel";
			arch = "arm64";
			os = "linux";
			compression = "gzip";
			load = <0x90008000>;
			entry = <0x90008000>;
			hash-1 {
				algo = "sha1";
			};
		};

		ramdisk-1 {
                        description = "Initial ramdisk";
                        data = /incbin/("./rb1_imgs/initramfs-tiny-image-qemuarm64-20230209073803-1343.rootfs.cpio.gz");
                        type = "ramdisk";
                        arch = "arm64";
                        os = "linux";
                        compression = "gzip";
                        load = <00000000>;
                        entry = <00000000>;
                        hash-1 {
                                algo = "sha1";
                        };
                };

		fdt-1 {
			description = "qrb2210-rb1-fdt";
			data = /incbin/("./rb1_imgs/qrb2210-rb1.dtb");
			type = "flat_dt";
			arch = "arm64";
			compression = "none";
			load = <0x94000000>;
			hash-1 {
				algo = "sha1";
			};
		};

	};

	configurations {
		default = "config-1";

		config-1 {
			description = "qrb2210-rb1 kernel-6.2-rc8 configuration";
			kernel = "kernel-1";
			ramdisk = "ramdisk-1";
			fdt = "fdt-1";
		};
	};
};
```

## board/qualcomm/rb3gen2-tfa.its
```
/*
 * This FIT configuration is used for development on the RB3 Gen 2. A
 * U-Boot image is flashed to the TZ partition, it starts in EL3 and allows
 * for the FIT image to be booted with "fastboot boot".
 */

/dts-v1/;

/ {
	description = "Configuration to boot TF-A, OP-TEE and U-Boot on RB3 Gen 2";
	#address-cells = <1>;

	images {
		tfa {
			description = "TF-A";
			data = /incbin/("../../.output/bl31.bin");
			type = "kernel";
			arch = "arm";
			os = "arm-trusted-firmware";
			compression = "none";
			load = <0x1c00e000>;
			entry = <0x1c00e000>;
			hash-1 {
				algo = "sha256";
			};
		};

		optee {
			description = "OP-TEE";
			data = /incbin/("../../.output/bl32.bin");
			type = "tee";
			arch = "arm";
			os = "tee";
			compression = "none";
			load = <0x1c120000>;
			entry = <0x1c120000>;
			hash-1 {
				algo = "sha256";
			};
		};

		/*
		 * This image clobbers the U-Boot image loaded from the
		 * uefi partition, it can be excluded to run that one instead
		 */
		uboot {
			description = "U-Boot itself";
			data = /incbin/("../../.output/u-boot-dtb.bin");
			// data = /incbin/("/home/cas/git/hvisor/target/aarch64-unknown-none/debug/hvisor.bin");
			type = "kernel";
			arch = "arm";
			os = "u-boot";
			compression = "none";
			load = <0x9fc00000>;
			entry = <0x9fc00000>;
			hash-1 {
				algo = "sha256";
			};
		};

		linux {
			description = "Linux kernel";
			data = /incbin/("../../.output/vmlinuz.efi");
			type = "kernel";
			arch = "arm";
			os = "efi";
			compression = "none";
			load = <0x80080000>;
			entry = <0x80080000>;
			hash-1 {
				algo = "sha256";
			};
		};

		initramfs {
			description = "pmOS Initramfs";
			data = /incbin/("../../.output/initramfs");
			type = "ramdisk";
			arch = "arm";
			compression = "none";
			load = <0x100000000>;
			entry = <0x100000000>;
			hash-1 {
				algo = "sha256";
			};
		}

		dtb {
			description = "DTB";
			// data = /incbin/("../../.output/u-boot-dtb.bin");
			data = /incbin/("../../.output/dts/upstream/src/arm64/qcom/qcs6490-rb3gen2.dtb");
			type = "flat_dt";
			arch = "arm";
			compression = "none";
			load = <0x9ec00000>;
			entry = <0x9ec00000>;
			hash-1 {
				algo = "sha256";
			};
		};
	};

	configurations {
		default = "load-tfa";

		load-tfa {
			description = "Boot the thing";
			kernel = "tfa";
			// U-Boot brings its own FDT
			// fdt = "fdt-1";
			loadables = "uboot", "optee", "dtb";
		};

		boot-linux {
			description = "Boot Linux";
			kernel = "linux";
			loadables = "initramfs", "dtb";
		};
	};
};
```

## board/qualcomm/rbx/Kconfig
```kconfig
if TARGET_QCOM_RBX

config SYS_BOARD
	default "rbx"

config SYS_VENDOR
	default "qualcomm"

config SYS_CONFIG_NAME
	string "Board configuration name"
	default "qcom-rbx"
	help
	  This option contains information about board configuration name.
	  Based on this option include/configs/<CONFIG_SYS_CONFIG_NAME>.h header
	  will be used for board configuration.

endif
```

## board/qualcomm/sdm845/Kconfig
```kconfig
if SDM845

config SYS_BOARD
	default "sdm845"

config SYS_VENDOR
	default "qualcomm"

config SYS_CONFIG_NAME
	string "Board configuration name"
	default "dragonboard845c" if TARGET_DRAGONBOARD845C
	default "sdm845"
	help
	  This option contains information about board configuration name.
	  Based on this option include/configs/<CONFIG_SYS_CONFIG_NAME>.h header
	  will be used for board configuration.

endif
```

## configs/qcom_armv7_defconfig
```kconfig
#include "qcom_defconfig"
CONFIG_ARM64=n
LINUX_KERNEL_IMAGE_HEADER=n
SYSRESET_PSCI=n

CONFIG_BAUDRATE=115200
CONFIG_DEBUG_UART=y
CONFIG_DEBUG_UART_ANNOUNCE=y
# db410c - 0x78b0000
# db820c - 0x75b0000
CONFIG_DEBUG_UART_BASE=0x16440000
CONFIG_DEBUG_UART_MSM=y
CONFIG_DEBUG_UART_CLOCK=7372800
#CONFIG_DEBUG_UART_SKIP_INIT=y

CONFIG_LOG=y
CONFIG_HEXDUMP=y
CONFIG_CMD_LOG=y
CONFIG_LOG_MAX_LEVEL=9
CONFIG_LOG_DEFAULT_LEVEL=9
CONFIG_LOGLEVEL=9
```

## configs/qcom_defconfig
```kconfig
CONFIG_ARM=y
CONFIG_SKIP_LOWLEVEL_INIT=y
CONFIG_POSITION_INDEPENDENT=y
CONFIG_ARCH_SNAPDRAGON=y
CONFIG_DEFAULT_DEVICE_TREE="sdm845-db845c"
CONFIG_SYS_LOAD_ADDR=0x0
CONFIG_BUTTON_CMD=y
CONFIG_FIT=y
CONFIG_FIT_VERBOSE=y
CONFIG_BOOTSTD_FULL=y
# CONFIG_BOOTMETH_VBE is not set
CONFIG_BOOTDELAY=1
CONFIG_USE_PREBOOT=y
CONFIG_SAVE_PREV_BL_INITRAMFS_START_ADDR=y
CONFIG_SYS_CBSIZE=512
# CONFIG_SYS_DEVICE_NULLDEV is not set
CONFIG_LOG_MAX_LEVEL=9
CONFIG_LOG_DEFAULT_LEVEL=4
# CONFIG_DISPLAY_CPUINFO is not set
CONFIG_DISPLAY_BOARDINFO_LATE=y
CONFIG_CMD_BOOTMENU=y
CONFIG_CMD_NVEDIT_EFI=y
CONFIG_CMD_CLK=y
CONFIG_CMD_GPIO=y
CONFIG_CMD_GPT=y
CONFIG_CMD_MMC=y
CONFIG_CMD_UFS=y
CONFIG_CMD_USB=y
CONFIG_CMD_USB_MASS_STORAGE=y
CONFIG_CMD_UMS_ABORT_KEYED=y
CONFIG_CMD_CAT=y
CONFIG_CMD_EXT4=y
CONFIG_CMD_EXT4_WRITE=y
CONFIG_CMD_BMP=y
CONFIG_CMD_EFIDEBUG=y
CONFIG_CMD_LOG=y
CONFIG_OF_LIVE=y
# CONFIG_NET is not set
# CONFIG_OFNODE_MULTI_TREE is not set
CONFIG_DM_WARN=y
CONFIG_BUTTON_QCOM_PMIC=y
CONFIG_CLK=y
CONFIG_CLK_QCOM_QCM2290=y
CONFIG_CLK_QCOM_QCS404=y
CONFIG_CLK_QCOM_SDM845=y
CONFIG_CLK_QCOM_SM6115=y
CONFIG_CLK_QCOM_SM8250=y
CONFIG_MSM_GPIO=y
CONFIG_QCOM_PMIC_GPIO=y
CONFIG_DM_KEYBOARD=y
CONFIG_BUTTON_KEYBOARD=y
CONFIG_MMC_HS200_SUPPORT=y
CONFIG_IOMMU=y
CONFIG_QCOM_HYP_SMMU=y
CONFIG_MISC=y
CONFIG_MMC_SDHCI=y
CONFIG_MMC_SDHCI_ADMA=y
CONFIG_MMC_SDHCI_MSM=y
CONFIG_PHY=y
CONFIG_PHY_QCOM_QMP_UFS=y
CONFIG_PHY_QCOM_QUSB2=y
CONFIG_PHY_QCOM_USB_HS_7NM=y
CONFIG_PINCTRL=y
CONFIG_PINCTRL_QCOM_QCM2290=y
CONFIG_PINCTRL_QCOM_QCS404=y
CONFIG_PINCTRL_QCOM_SDM845=y
CONFIG_PINCTRL_QCOM_SM6115=y
CONFIG_PINCTRL_QCOM_SM8250=y
CONFIG_DM_PMIC=y
CONFIG_PMIC_QCOM=y
CONFIG_DM_REGULATOR=y
CONFIG_DM_REGULATOR_GPIO=y
CONFIG_DM_RTC=y
CONFIG_RTC_EMULATION=y
CONFIG_SCSI=y
CONFIG_MSM_SERIAL=y
CONFIG_MSM_GENI_SERIAL=y
CONFIG_SPMI_MSM=y
CONFIG_SYSINFO=y
CONFIG_SYSINFO_SMBIOS=y
CONFIG_USB=y
CONFIG_USB_XHCI_HCD=y
CONFIG_USB_XHCI_DWC3=y
CONFIG_USB_DWC3=y
CONFIG_USB_DWC3_GENERIC=y
CONFIG_USB_STORAGE=y
CONFIG_USB_GADGET=y
CONFIG_USB_GADGET_DOWNLOAD=y
CONFIG_USB_FUNCTION_ACM=y
CONFIG_USB_GADGET_VENDOR_NUM=0x18d1
CONFIG_USB_GADGET_PRODUCT_NUM=0xd00d
CONFIG_USB_HOST_ETHER=y
CONFIG_USB_ETHER_ASIX88179=y
CONFIG_CMD_DHCP=y
CONFIG_UFS=y
CONFIG_QCOM_UFS=y
CONFIG_VIDEO=y
# CONFIG_VIDEO_FONT_8X16 is not set
CONFIG_VIDEO_FONT_16X32=y
CONFIG_SYS_WHITE_ON_BLACK=y
CONFIG_NO_FB_CLEAR=y
CONFIG_VIDEO_SIMPLE=y
CONFIG_SMBIOS=y
CONFIG_EFI_SET_TIME=y
CONFIG_LMB_MAX_REGIONS=64
CONFIG_EFI_RUNTIME_UPDATE_CAPSULE=y
CONFIG_EFI_CAPSULE_ON_DISK=y
CONFIG_EFI_IGNORE_OSINDICATIONS=y
CONFIG_CMD_DFU=y
CONFIG_EFI_CAPSULE_FIRMWARE_RAW=y
CONFIG_DFU_SCSI=y
CONFIG_SYS_DFU_MAX_FILE_SIZE=0x200000
CONFIG_SYS_DFU_DATA_BUF_SIZE=0x200000
CONFIG_SYS_MALLOC_LEN=0x300000
CONFIG_TOOLS_MKEFICAPSULE=y
CONFIG_EFI_CAPSULE_ON_DISK_EARLY=y
CONFIG_SOC_QCOM=y
CONFIG_QCOM_COMMAND_DB=y
CONFIG_QCOM_RPMH=y
CONFIG_DM_REGULATOR_QCOM_RPMH=y
CONFIG_CMD_REGULATOR=y
```

## configs/rb1_defconfig
```kconfig
CONFIG_ARM=y
CONFIG_SKIP_LOWLEVEL_INIT=y
CONFIG_COUNTER_FREQUENCY=19200000
CONFIG_POSITION_INDEPENDENT=y
CONFIG_ARCH_SNAPDRAGON=y
CONFIG_NR_DRAM_BANKS=2
CONFIG_DEFAULT_DEVICE_TREE="qrb2210-rb1"
CONFIG_DM_RESET=y
CONFIG_TARGET_RB1=y
CONFIG_IDENT_STRING="\nQualcomm QRB2210 RB1"
CONFIG_SYS_LOAD_ADDR=0x90008000
CONFIG_FIT=y
CONFIG_FIT_VERBOSE=y
CONFIG_BOOTDELAY=5
CONFIG_USE_BOOTARGS=y
CONFIG_BOOTARGS="earlycon ignore_loglevel root=/dev/mmcblk1p2 clk_ignore_unused"
CONFIG_SAVE_PREV_BL_FDT_ADDR=y
CONFIG_SAVE_PREV_BL_INITRAMFS_START_ADDR=y
# CONFIG_DISPLAY_CPUINFO is not set
CONFIG_HUSH_PARSER=y
CONFIG_SYS_MAXARGS=64
CONFIG_SYS_CBSIZE=512
CONFIG_CMD_GPIO=y
CONFIG_CMD_GPT=y
CONFIG_CMD_MMC=y
CONFIG_CMD_PART=y
CONFIG_CMD_USB=y
CONFIG_CMD_EXT2=y
CONFIG_CMD_EXT4=y
CONFIG_CMD_EXT4_WRITE=y
CONFIG_CMD_FAT=y
CONFIG_CMD_FS_GENERIC=y
CONFIG_MULTI_DTB_FIT=y
# CONFIG_NET is not set
CONFIG_DM_DMA=y
CONFIG_REGMAP=y
CONFIG_SYSCON=y
CONFIG_DEVRES=y
CONFIG_SIMPLE_BUS_CORRECT_RANGE=y
CONFIG_CLK=y
CONFIG_MSM_GPIO=y
CONFIG_QCOM_PMIC_GPIO=y
CONFIG_MISC=y
CONFIG_MMC_HS400_SUPPORT=y
CONFIG_MMC_SDHCI=y
CONFIG_MMC_SDHCI_ADMA=y
CONFIG_MMC_SDHCI_MSM=y
CONFIG_PHY=y
CONFIG_PHY_QCOM_USB_HS_28NM=y
CONFIG_PHY_QCOM_USB_SS=y
CONFIG_PINCTRL=y
CONFIG_DM_PMIC=y
CONFIG_PMIC_QCOM=y
CONFIG_DEBUG_UART_BASE=0x4a90000
CONFIG_MSM_GENI_SERIAL=y
CONFIG_REQUIRE_SERIAL_CONSOLE=y
CONFIG_SPMI_MSM=y
CONFIG_USB=y
CONFIG_USB_XHCI_HCD=y
CONFIG_USB_XHCI_DWC3=y
CONFIG_USB_DWC3=y
CONFIG_USB_DWC3_GENERIC=y
CONFIG_USB_STORAGE=y
CONFIG_LMB_MAX_REGIONS=64
```
