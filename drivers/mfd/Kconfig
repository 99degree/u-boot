## drivers/mfd/Kconfig
```kconfig
config MFD_ATMEL_SMC
       bool "Atmel Static Memory Controller driver"
       help
	Say yes here to support Atmel Static Memory Controller driver.

config MFD_QCOM_PON
       bool "QCOM PMIC PON MFD driver"
       default y if ARCH_SNAPDRAGON
       help
        Say yes here to support QCOM PMIC PON MFD driver for reboot-mode,
	button driver(including pwrkey, resin driver, etc).
```
