/dts-v1/;
	/ {
		model = "Qualcomm Technologies, Inc. QRB4210 RB2";
		compatible = "qcom,qrb4210-rb2", "qcom,sm6115";

		#address-cells = <2>;
		#size-cells = <2>;

		memory@80000000 {
			device_type = "memory";
			/* We expect the bootloader to fill in the size */
			reg = <0 0x80000000 0 0>;
		};

		chosen { };
	};
